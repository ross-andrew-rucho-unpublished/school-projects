// Bob's pin definitions for PIC16F1829 for I2C communication:
#define res pin_b5
#define sa0 pin_c2=1
#define scl pin_b6
#define sda pin_b4



/*  Kennys pin assignments for PIC18F4550 for I2C communication:
#define res pin_b3
#define sa0 pin_b2=1
#define scl pin_b1
#define sda pin_b0
*/


// Number of pixels in LCD
#define LCD_X     128
#define LCD_Y     64


int char_row,charsel,charpos,chardata;       // for nokia_5110 lcd

int16 ddram;

//char plot_value;

int32 plot_value32;

int32 plot_umsb,plot_lmsb,plot_ulsb,plot_llsb;

// ASCII table for NOKIA LCD and OLED: 96 rows * 5 bytes= 480 bytes

BYTE const TABLE5[240]=            {0x00,0x00,0x00,0x00,0x00,     //  20 space 

  0x00,0x00,0x5f,0x00,0x00,   // 21 !
  0x00,0x07,0x00,0x07,0x00,   // 22 "
  0x14,0x7f,0x14,0x7f,0x14,   // 23 #
//  0x24,0x2a,0x7f,0x2a,0x12,   // 24 $   // original pixels for "$" symbol
  0x06,0x09,0x09,0x06,0x00,   // 24 $     
// I have changed the display value for the ASCII symbol "$" to the degree symbol "°"  RG Dennis
  0x23,0x13,0x08,0x64,0x62,   // 25 %
  0x36,0x49,0x55,0x22,0x50,   // 26 &
  0x00,0x05,0x03,0x00,0x00,   // 27 '
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  0x00,0x41,0x22,0x14,0x08,   // 3e >
//  0x02,0x01,0x51,0x09,0x06,   // 3f ?  // original pixels for "?" symbol
  0x41,0x63,0x55,0x49,0x41,   // 3f ?
// I have changed the display value for the ASCII symbol "?" to the summation symbol Ross Rucho
  0x32,0x49,0x79,0x41,0x3e,   // 40 @
  0x7e,0x11,0x11,0x11,0x7e,   // 41 A
  0x7f,0x49,0x49,0x49,0x36,   // 42 B
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  0x3e,0x41,0x41,0x41,0x3e    // 4f O
};   


BYTE const TABLE6[240]=            {0x7f,0x09,0x09,0x09,0x06,   // 50 P
  0x3e,0x41,0x51,0x21,0x5e,   // 51 Q
  0x7f,0x09,0x19,0x29,0x46,   // 52 R
  0x46,0x49,0x49,0x49,0x31,   // 53 S
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  0x78,0x46,0x41,0x46,0x78    // 7f
}; 


void iic_start(){
output_high(scl);
delay_us(1);
output_high(sda);
delay_us(1);
output_low(sda);
delay_us(1);
output_low(scl);
delay_us(1);
}

void iic_stop(){
output_low(scl);
delay_us(1);
output_low(sda);
delay_us(1);
output_high(scl);
delay_us(1);
output_high(sda);
delay_us(1);
}

void iic_write(byte iic_byte){
int i;
for (i=0;i<8;i++) {
output_bit(sda, shift_left(&iic_byte,1,0));
output_high(scl) ;
delay_us(1);
output_low(scl) ;
delay_us(1);
}
output_high(sda);
output_high(scl);
delay_us(1);
output_low(scl);
delay_us(1);
}

void oled_write_data(byte iic_data){
iic_start();
iic_write(0x78);
iic_write(0x40);
iic_write(iic_data);
iic_stop();
}

void oled_write_command(byte iic_command){
iic_start();
iic_write(0x78);
iic_write(0x00);
iic_write(iic_command);
iic_stop();
}

void initialise_screen(){
oled_write_command(0xae);
oled_write_command(0x20);
oled_write_command(0x10);
oled_write_command(0xb0);
oled_write_command(0xc8);
oled_write_command(0x00);
oled_write_command(0x10);
oled_write_command(0x40);
oled_write_command(0x81);
oled_write_command(0xaf);
oled_write_command(0xa1);
oled_write_command(0xa6);
oled_write_command(0xa8);
oled_write_command(0x3f);
oled_write_command(0xa4);
oled_write_command(0xd3);
oled_write_command(0x00);
oled_write_command(0xd5);
oled_write_command(0xf0);
oled_write_command(0xd9);
oled_write_command(0x22);
oled_write_command(0xda);
oled_write_command(0x12);
oled_write_command(0xdb);
oled_write_command(0x20);
oled_write_command(0x8d);
oled_write_command(0x14);
oled_write_command(0xaf);
}

void table_to_oled(void){
if (charsel<0x20)return;
  if (charsel>0x7f)return;

  for (char_row=0;char_row<5;char_row++) {      // 5 bytes

    if (charsel<0x50){charpos=(((charsel&0xff)-0x20)*5);chardata=TABLE5[(charpos+char_row)];}            // use TABLE5
    else if (charsel>0x4f){charpos=(((charsel&0xff)-0x50)*5);chardata=TABLE6[(charpos+char_row)];}            // use TABLE6


    oled_write_data(chardata);      // send data to oled
  }

  oled_write_data(0x00);      //    1 byte (always blank)

}

void oled_printchar(int cvar){
charsel=cvar;
table_to_oled();
}



void clear_screen(void){
int m,n;
for(m=0;m<8;m++){
oled_write_command(0xb0+m);
oled_write_command(0x00);
oled_write_command(0x10);
for(n=0;n<128;n++) {
oled_write_data(0x00);
}
}
}

void fill_screen(void){
int m,n;
for(m=0;m<8;m++){
oled_write_command(0xb0+m);
oled_write_command(0x00);
oled_write_command(0x10);
for(n=0;n<128;n++) {
oled_write_data(0xff);
}
}
}

void oled_gotoxy(int page, int column){
byte column_lower=0x00;
byte column_upper=0x10;
byte page_start=0xb0;
page_start=page_start+page;
column_upper=(column_upper+column/16);
column_lower=(column_lower+column%16);
oled_write_command(page_start);
oled_write_command(column_lower);
oled_write_command(column_upper);
}

void oled_zoom(void){
//  These four lines (two 2-byte commands) set ZOOM IN mode (characters are twice as high)
//  see SSD1306-1.2 user manual for OLED driver, pages 33, 34, and 49
  oled_write_command(0xda);     
  oled_write_command(0x12);
  oled_write_command(0xd6);
  oled_write_command(0x01);
}

void vertical_line(int length){

}

void oled_drawbox(int width, int height){

}
